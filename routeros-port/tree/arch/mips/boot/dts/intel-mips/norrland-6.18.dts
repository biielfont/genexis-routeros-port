// SPDX-License-Identifier: GPL-2.0-only
/*
 * Genexis Pure ED500 (norrland) - GRX350
 *
 * Placa minima sobre el dtsi del SoC de grische (kernel 6.18), que es el que
 * trae el driver Ethernet funcional (CBM/DQM + DSA). Los datos de la placa
 * vienen del U-Boot de Genexis: DDR en 0x20000000 con 224 MiB utiles,
 * consola ttyLTQ0 en 0x16600000, NAND de 128 MiB en 0x17c00000.
 */
/dts-v1/;

#include "xrx500.dtsi"

/ {
	model = "Genexis Pure ED500 (GRX350)";
	compatible = "genexis,pure-ed500", "intel,xrx500";

	aliases {
		serial0 = &asc0;
	};

	chosen {
		/*
		 * earlycon=lantiq escribe sin reprogramar el baud: hereda el
		 * divisor que dejo U-Boot a 115200. clk_ignore_unused evita
		 * que se apaguen clocks que el firmware del GPHY necesita.
		 */
		bootargs = "console=ttyLTQ0,115200 earlycon=lantiq,0x16600000 clk_ignore_unused mem=224M@512M";
		stdout-path = "serial0:115200n8";
	};

	memory@20000000 {
		device_type = "memory";
		reg = <0x20000000 0x0e000000>;
	};
};
